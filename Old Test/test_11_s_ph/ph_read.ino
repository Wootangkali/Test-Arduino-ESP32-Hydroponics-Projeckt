void phRead(void)
{


  //    byte pHValue, voltage;                                                            // Объявляем переменные для хранения значений напряжения и pH
  //  Проводим измерения:                                                                       //
  if (millis() - samplingTime > samplingInterval) {                                         // Выполняем код в теле оператора if через каждые samplingInterval мс
    pHArray[pHArrayIndex++] = analogRead(SensorPin) - 1023 ;                                     // Читаем данные в очередной элемент массива pHArray
    if (pHArrayIndex == ArrayLenth) pHArrayIndex = 0;                                     // Если достигли последнего элемента массива pHArray, то сбрасываем номер текущего элемента этого массива в 0
    voltage = 5.026601 / 1024 * averagearray(pHArray, ArrayLenth);                          // Получаем среднее напряжение в мВ из массива напряжений pHArray
    pHValue = - 6.15 * voltage + Offset;                                                     // Преобразуем мВ в pH
    samplingTime = millis();                                                              // Обновляем время для переменной samplingTime

  }                                                                                         //
  ////  Выводим показания в монитор:                                                              //
  //    if(millis() - printTime > printInterval){                                                 // Выполняем код в теле оператора if через каждые printInterval мс
  //        Serial.print("Voltage:");                                                             // Выводим надпись "Voltage:"
  //        Serial.print(voltage,2);                                                              // Выводим среднее напряжение
  //        Serial.print("    pH value: ");                                                       // Выводим надпись "    pH value: "
  //        Serial.println(pHValue,2);                                                            // Выводим значение pH
  //        digitalWrite(LED,digitalRead(LED)^1);                                                 // Меняем состояние светодиода
  //        printTime = millis();                                                                 // Обновляем время для переменной printTime
  //    }                                                                                         //
}                                                                                             //
//
//  Функция определения среднего значения напряжения                                          // Эта функция возвращает среднее арифметическое значение данных массива arr без учёта одного максимального и одного минимального значения массива.
double averagearray(int* arr, int number) {                                                   //
  int i, max, min;                                                                          // Объявляем переменные для цикла и экстремумов
  double avg;                                                                               // Объявляем переменную для вывода среднего значения
  long amount = 0;                                                                          // Определяем переменную для подсчёта среднего значения
  if (number <= 0) {
    Serial.println("Error number for the array to avraging!/n");   // В массиве arr не может быть 0 и менее элементов
    return 0;
  }
  if (number < 5) {
    for (i = 0; i < number; i++) {
      amount += arr[i];
    } avg = amount / number; return avg; // Если в массиве arr менее 5 элементов, то среднее значение является средним арифметическим значением
  } else {                                                                                   // Если в массиве arr более 5 элементов, то среднее значение считаем иначе ...
    if (arr[0] < arr[1]) {
      min = arr[0];  // Определяем минимальное и максимальное число из первых двух элементов массива
      max = arr[1];
    }
    else             {
      min = arr[1];  // Определяем минимальное и максимальное число из первых двух элементов массива
      max = arr[0];
    }
    for (i = 2; i < number; i++) {                                                        // Проходим по остальным элементам массива
      if (arr[i] < min) {
        amount += min;  // Если значение очередного элемента меньше минимального,  то добавляем к значению amount предыдущее минимальное значение  и обновляем значение min
        min = arr[i];
      }
      else if (arr[i] > max) {
        amount += max;  // Если значение очередного элемента больше максимального, то добавляем к значению amount предыдущее максимальное значение и обновляем значение max
        max = arr[i];
      }
      else               {
        amount += arr[i];           // Если значение очередного элемента находится в пределах между min и max, то добавляем значение этого элемента к amount
      }
    }                                                                                     //
    avg = (double) amount / (number - 2);                                                 // Получаем среднее арифметическое значение (без учета значений первых двух элементов массива arr, т.к. они не добавлялись к amount)
  }                                                                                         //
  return avg;                                                                               // Возвращаем полученное среднее значение

}
